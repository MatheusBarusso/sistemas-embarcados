#include <Arduino.h>
#include <Wire.h>
#include <Adafruit_GFX.h>
#include <Adafruit_SSD1306.h>
// #include "Joystick.h" 
#include "USB.h"
#include "USBHIDGamepad.h"
#include "GenesisController.h"
#include "NESController.h"
#include "NGCController.h"

// --- DISPLAY CONFIGURATION ---
#define SCREEN_WIDTH 128
#define SCREEN_HEIGHT 64

// Your new I2C pins
#define SDA_PIN 35
#define SCL_PIN 48

// Create the display object
Adafruit_SSD1306 display(SCREEN_WIDTH, SCREEN_HEIGHT, &Wire, -1);

// HID and definition of PINOUTS
USBHIDGamepad gamepad;
GenesisController genesis(4, 5, 6, 7, 15, 17, 16);
NESController nes(18, 9, 8); //latch pulse data
NGCController ngc(10);

// --- CONTROLLER CONFIGURATION ---
// Pins: X on 5, Y on 4, Button on 6 
// Joystick controller(19, 2, 1);

int current_item = 0;
bool is_selected = false;

#define BTN_1 1 //Navigation
#define BTN_2 2 //Select
#define LED_NES 13
#define LED_GEN 14
#define LED_NGC 12

// 'euu', 128x32px
// 'Design sem nome (2)', 128x32px

const unsigned char selection_screen [] PROGMEM = {
	0x00, 0x00, 0x00, 0x00, 0x00, 0x00, 0x00, 0x00, 0x00, 0x00, 0x00, 0x00, 0x00, 0x00, 0x00, 0x00, 
0x00, 0x00, 0x00, 0x00, 0x00, 0x00, 0x00, 0x00, 0x00, 0x00, 0x00, 0x00, 0x00, 0x00, 0x00, 0x00, 
0x00, 0x00, 0x00, 0x00, 0x00, 0x00, 0x00, 0x00, 0x00, 0x00, 0x00, 0x00, 0x00, 0x00, 0x00, 0x00, 
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0x00, 0x00, 0x00, 0x00, 0x00, 0x00, 0x00, 0x00, 0x00, 0x00, 0x00, 0x00, 0x00, 0x00, 0x00, 0x00
};


const unsigned char NES [] PROGMEM = {
	0x00, 0x00, 0x00, 0x00, 0x00, 0x00, 0x00, 0x00, 0x00, 0x00, 0x00, 0x00, 0x00, 0x00, 0x00, 0x00, 
0x00, 0x00, 0x00, 0x00, 0x00, 0x00, 0x00, 0x00, 0x00, 0x00, 0x00, 0x00, 0x00, 0x00, 0x00, 0x00, 
0x00, 0x00, 0x00, 0x00, 0x00, 0x00, 0x00, 0x00, 0x00, 0x00, 0x00, 0x00, 0x00, 0x00, 0x00, 0x00, 
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0x00, 0x00, 0x00, 0x00, 0x00, 0x00, 0x00, 0x00, 0x00, 0x00, 0x00, 0x00, 0x00, 0x00, 0x00, 0x00
};

const unsigned char NES_selected [] PROGMEM = {
0x00, 0x00, 0x00, 0x00, 0x00, 0x00, 0x00, 0x00, 0x00, 0x00, 0x00, 0x00, 0x00, 0x00, 0x00, 0x00, 
0x00, 0x00, 0x00, 0x00, 0x00, 0x00, 0x00, 0x00, 0x00, 0x00, 0x00, 0x00, 0x00, 0x00, 0x00, 0x00, 
0x00, 0x00, 0x00, 0x00, 0x00, 0x00, 0x00, 0x00, 0x00, 0x00, 0x00, 0x00, 0x00, 0x00, 0x00, 0x00, 
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0x00, 0x00, 0x00, 0x00, 0x00, 0x00, 0x00, 0x00, 0x00, 0x00, 0x00, 0x00, 0x00, 0x00, 0x00, 0x00
};

const unsigned char GENESIS [] PROGMEM = {
	0x00, 0x00, 0x00, 0x00, 0x00, 0x00, 0x00, 0x00, 0x00, 0x00, 0x00, 0x00, 0x00, 0x00, 0x00, 0x00, 
0x00, 0x00, 0x00, 0x00, 0x00, 0x00, 0x00, 0x00, 0x00, 0x00, 0x00, 0x00, 0x00, 0x00, 0x00, 0x00, 
0x00, 0x00, 0x00, 0x00, 0x00, 0x00, 0x00, 0x00, 0x00, 0x00, 0x00, 0x00, 0x00, 0x00, 0x00, 0x00, 
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0x00, 0x00, 0x00, 0x00, 0x00, 0x00, 0x00, 0x00, 0x00, 0x00, 0x00, 0x00, 0x00, 0x00, 0x00, 0x00
};

const unsigned char GENESIS_selected [] PROGMEM = {
	0x00, 0x00, 0x00, 0x00, 0x00, 0x00, 0x00, 0x00, 0x00, 0x00, 0x00, 0x00, 0x00, 0x00, 0x00, 0x00, 
0x00, 0x00, 0x00, 0x00, 0x00, 0x00, 0x00, 0x00, 0x00, 0x00, 0x00, 0x00, 0x00, 0x00, 0x00, 0x00, 
0x00, 0x00, 0x00, 0x00, 0x03, 0xff, 0x80, 0x00, 0x00, 0x00, 0x7f, 0xe0, 0x00, 0x00, 0x00, 0x00, 
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0x00, 0x00, 0x00, 0x00, 0x00, 0x00, 0x00, 0x00, 0x00, 0x00, 0x00, 0x00, 0x00, 0x00, 0x00, 0x00, 


};

const unsigned char GNC [] PROGMEM = {
	0x00, 0x00, 0x00, 0x00, 0x00, 0x00, 0x00, 0x00, 0x00, 0x00, 0x00, 0x00, 0x00, 0x00, 0x00, 0x00, 
0x00, 0x00, 0x00, 0x00, 0x00, 0x00, 0x00, 0x00, 0x00, 0x00, 0x00, 0x00, 0x00, 0x00, 0x00, 0x00, 
0x00, 0x00, 0x00, 0x00, 0x00, 0x00, 0x00, 0x00, 0x00, 0x00, 0x00, 0x00, 0x00, 0x00, 0x00, 0x00, 
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0x00, 0x00, 0x00, 0x00, 0x00, 0x00, 0x00, 0x00, 0x00, 0x00, 0x00, 0x00, 0x00, 0x00, 0x00, 0x00
};

const unsigned char GNC_selected [] PROGMEM = {
	0x00, 0x00, 0x00, 0x00, 0x00, 0x00, 0x00, 0x00, 0x00, 0x00, 0x00, 0x00, 0x00, 0x00, 0x00, 0x00, 
0x00, 0x00, 0x00, 0x00, 0x00, 0x00, 0x00, 0x03, 0xe0, 0x00, 0x00, 0x00, 0x00, 0x00, 0x00, 0x00, 
0x00, 0x00, 0x00, 0x00, 0x00, 0x00, 0x0f, 0xff, 0xff, 0xf0, 0x00, 0x00, 0x00, 0x00, 0x00, 0x00, 
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0x00, 0x00, 0x00, 0x00, 0x00, 0x00, 0x00, 0x00, 0x00, 0x00, 0x00, 0x00, 0x00, 0x00, 0x00, 0x00
};

// Array of all bitmaps for convenience. (Total bytes used to store images in PROGMEM = 528)
const int epd_bitmap_allArray_LEN = 1;
const unsigned char* epd_bitmap_allArray[7] = {
  selection_screen,
	NES,
  NES_selected,
  GENESIS,
  GENESIS_selected,
  GNC,
  GNC_selected
};

// --- HELPER FUNCTION ---
// We use this so we don't have to repeat screen commands in the loop
void showOnScreen(String message) {
  display.clearDisplay();              // Clear the old text
  display.setTextSize(2);              // Size 2 makes it nice and big
  display.setTextColor(SSD1306_WHITE); // White text
  
  // Set cursor slightly down from the top to center it (x=0, y=8)
  display.setCursor(0, 8);             
  display.println(message);
  
  display.display();                   // Send the buffer to the screen
  
  // Keep sending to Serial Monitor just in case you need to debug
  Serial.println(message);             
}

void showBitmap(const unsigned char* bitmap, int width, int height) {
  display.clearDisplay();
  display.drawBitmap(0, 0, bitmap, width, height, SSD1306_WHITE);
  display.display();
}

void select_image() {
  const unsigned char* imagens[] = {NES, GENESIS, GNC};
  const unsigned char* imagens_sel[] = {NES_selected, GENESIS_selected, GNC_selected};

  if (is_selected) {
    showBitmap(imagens_sel[current_item], 128, 64);
  } else {
    showBitmap(imagens[current_item], 128, 64);
  }
}

void setup() {
  Serial.begin(115200);
  delay(1000);

  pinMode(BTN_1, INPUT_PULLUP);
  pinMode(BTN_2, INPUT_PULLUP);
  pinMode(LED_NES, OUTPUT);
  pinMode(LED_GEN, OUTPUT);
  pinMode(LED_NGC, OUTPUT);
  digitalWrite(LED_NES, LOW);
  digitalWrite(LED_GEN, LOW);
  digitalWrite(LED_NGC, LOW);
  
  // 1. Start the Joystick and controllers
  // controller.begin();
  genesis.begin();
  nes.begin();
  ngc.begin();
  USB.productName("Retro USB Adapter");
  USB.begin();
  gamepad.begin();

  // 2. Start the I2C bus with your specific pins
  Wire.begin(SDA_PIN, SCL_PIN);

  // 3. Start the OLED Display
  if(!display.begin(SSD1306_SWITCHCAPVCC, 0x3C)) {
    Serial.println(F("SSD1306 failed! Check wiring."));
    for(;;); // Freeze here if the screen doesn't connect
  }

  // Show an initial message
  showBitmap(selection_screen, 128, 64);
}

void loop() {

  // Navegation
  if (!is_selected) {
    if (digitalRead(BTN_1) == LOW) {
      while(digitalRead(BTN_1) == LOW) {
        delay(100);
      }
      current_item = (current_item + 1) % 3;
      select_image();
    }
  }

  if (digitalRead(BTN_2) == LOW) {
      while(digitalRead(BTN_2) == LOW) {
        delay(100);
      }
      is_selected = !is_selected;
      select_image();
    }

  if (is_selected) {
    ControllerState s = {0, 0, 0, 0, 0, 0, 0, 0};
    
    if (current_item == 0) { 
      digitalWrite(LED_NES, HIGH);
      digitalWrite(LED_GEN, LOW);
      digitalWrite(LED_NGC, LOW);
      s = nes.read();
    } 
    else if (current_item == 1) {
      digitalWrite(LED_GEN, HIGH);
      digitalWrite(LED_NES, LOW);
      digitalWrite(LED_NGC, LOW);
      s = genesis.read();
    }
    else if (current_item == 2) {
      digitalWrite(LED_NGC, HIGH); 
      digitalWrite(LED_GEN, LOW);
      digitalWrite(LED_NES, LOW);
      s = ngc.read();
    }

    gamepad.send(
      s.x, s.y, s.z,     
      s.rz, s.rx, s.ry,  
      s.hat,
      s.buttons
    );

    delay(10);
  }
  else {
    // Quando volta para o Menu (is_selected = false), desliga ambos os LEDs
    digitalWrite(LED_NES, LOW);
    digitalWrite(LED_GEN, LOW);
    digitalWrite(LED_NGC, LOW);
    
    // Envia estado neutro para o PC
    gamepad.send(0, 0, 0, 0, 0, 0, 0, 0);
  }
}